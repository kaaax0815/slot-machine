// '7', 30x30px
const uint16_t epd_bitmap_7 [] PROGMEM = {
  0x0000, 0x0000, 0x0000, 0x0000, 0x0000, 0x0000, 0x0000, 0x0000, 0x0000, 0x0000, 0x0000, 0x0000, 0x0000, 0x0000, 0x0000, 0x0000, 
  0x0000, 0x0000, 0x0000, 0x0000, 0x0000, 0x0000, 0x0000, 0x0000, 0x0000, 0x0000, 0x0000, 0x0000, 0x0000, 0x0000, 0x0000, 0x0000, 
  0x0000, 0x0000, 0x0000, 0x0000, 0x0000, 0x0000, 0x0000, 0x0000, 0x0000, 0x0000, 0x0000, 0x0000, 0x0000, 0x0000, 0x0000, 0x0000, 
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  0x0000, 0x0000, 0x0000, 0x0000
};

// 'orange', 30x30px
const uint16_t epd_bitmap_orange [] PROGMEM = {
  0x0000, 0x0000, 0x0000, 0x0000, 0x0000, 0x0000, 0x0000, 0x0000, 0x0000, 0x0000, 0x0000, 0x0000, 0x0000, 0x0000, 0x0000, 0x0000, 
  0x0000, 0x0000, 0x0000, 0x0000, 0x0000, 0x0000, 0x0000, 0x0000, 0x0000, 0x0000, 0x0000, 0x0000, 0x0000, 0x0000, 0x0000, 0x0000, 
  0x0000, 0x0000, 0x0000, 0x0000, 0x0000, 0x0000, 0x0000, 0x0000, 0x0000, 0x0000, 0x0000, 0x0000, 0x0000, 0x0000, 0x0000, 0x0000, 
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  0x0000, 0x0000, 0x0000, 0x0000
};

// 'cherry', 30x30px
const uint16_t epd_bitmap_cherry [] PROGMEM = {
  0x0000, 0x0000, 0x0000, 0x0000, 0x0000, 0x0000, 0x0000, 0x0000, 0x0000, 0x0000, 0x0000, 0x07e0, 0x0000, 0x0962, 0x0000, 0x0000, 
  0x0000, 0x0000, 0x0000, 0x0000, 0x0000, 0x0000, 0x0000, 0x0000, 0x0000, 0x0000, 0x0000, 0x0000, 0x0000, 0x0000, 0x0000, 0x0000, 
  0x0000, 0x0000, 0x0000, 0x0000, 0x0000, 0x0000, 0x0000, 0x0000, 0x0000, 0x3da9, 0x3da9, 0x3da9, 0x3da9, 0x3da9, 0x3da9, 0x0000, 
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  0x0000, 0x0000, 0x0000, 0x0000
};

// 'melon', 30x30px
const uint16_t epd_bitmap_melon [] PROGMEM = {
  0x0000, 0x0000, 0x0000, 0x0000, 0xe209, 0xe209, 0xe209, 0xe209, 0x0000, 0x0000, 0x0000, 0x0000, 0x0000, 0x0000, 0x0000, 0x0000, 
  0x0000, 0x0000, 0x0000, 0x0000, 0x0000, 0x0000, 0x0000, 0x0000, 0x0000, 0x0000, 0x0000, 0x0000, 0x0000, 0x0000, 0x0000, 0x0000, 
  0x0000, 0xe209, 0xe209, 0xe209, 0xe209, 0xe209, 0xe209, 0xe209, 0x0000, 0x0000, 0x0000, 0x0000, 0x0000, 0x0000, 0x0000, 0x0000, 
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  0x0000, 0x0000, 0x0000, 0x0000
};

// Common
#include <SPI.h>

// TFT
#include <Adafruit_GFX.h>
#include <Adafruit_ST7735.h>
#define TFT_CS 10
#define TFT_RST 8
#define TFT_DC 9
#define TFT_HEIGHT 160
#define TFT_WIDTH 128

Adafruit_ST7735 tft = Adafruit_ST7735(TFT_CS, TFT_DC, TFT_RST);

// Keypad
#include <Keypad.h>

const int ROW_NUM = 4;
const int COLUMN_NUM = 4;

char keys[ROW_NUM][COLUMN_NUM] = {
  {'1', '2', '3', 'A'},
  {'4', '5', '6', 'B'},
  {'7', '8', '9', 'C'},
  {'*', '0', '#', 'D'}
};

byte pin_rows[ROW_NUM] = {7, 6, 5, 4};
byte pin_column[COLUMN_NUM] = {3, 2, 1, 0};

Keypad keypad = Keypad(makeKeymap(keys), pin_rows, pin_column, ROW_NUM, COLUMN_NUM);

// UI
#define UI_RECT_Y 62
#define UI_RECT_WIDTH 36
#define UI_RECT_R 2

int UI_RECT_SPACE = (TFT_WIDTH - (3 * UI_RECT_WIDTH)) / 4;
int UI_RECT0_X = UI_RECT_SPACE;
int UI_RECT1_X = UI_RECT0_X + UI_RECT_WIDTH + UI_RECT_SPACE;
int UI_RECT2_X = UI_RECT1_X + UI_RECT_WIDTH + UI_RECT_SPACE;
int UI_RECTS[] = {UI_RECT0_X, UI_RECT1_X, UI_RECT2_X};

#define UI_ITEM_WIDTH 30

// Logic
long balance = 1500;
#define BET 50

void setup(void) {
  // Initialize Serial & SPI & TFT
  Serial.begin(9600);
  Serial.println("setup");
  SPI.begin();

  tft.initR(INITR_BLACKTAB);

  Serial.println("done");
  delay(1000);

  printUI();
}

void loop() {
  char key = keypad.getKey();
  Serial.println(key);

  if (key == '*') {
    Serial.println("Generating...");

    // If no money
    if (balance < BET) {
      printLowBalance();
      return;
    }

    // Generate 3 Random Numbers
    int RND_ITEMS = 4;

    balance = balance - BET;

    printUI();

    long int rnds[3] = {random(0,RND_ITEMS), random(0,RND_ITEMS), random(0,RND_ITEMS)};

    // Fill Slots
    for (int i = 0; i < 3; i++) {
      int rnd = rnds[i];
      if (rnd == 0) {
        printMelon(i);
      } else if (rnd == 1) {
        printOrange(i);
      } else if (rnd == 2) {
        printCherry(i);
      } else if (rnd == 3) {
        print7(i);
      }
    }

    // Calculate Payout
    if (rnds[0] == rnds[1] && rnds[0] == rnds[2]) {
      if (rnds[0] == 3) {
        printWin(5000);
      } else if (rnds[0] == 2 || rnds[0] == 1) {
        printWin(500);
      } else if (rnds[0] == 0) {
        printWin(2500);
      } 
    }
  } else if (key == '7') {
    // Reset
    balance = 1500;
    printUI();
  } else if (key == '1') {
    // Credits
    printAuthors();
  } else if (key == '4') {
    // Payout Table
    printHelp();  
  }

  delay(5);
}

// Draw Empty UI on Screen
void printUI() {
  tft.fillScreen(ST7735_BLACK);
  tft.setCursor(0, 0);
  tft.setTextColor(ST77XX_YELLOW);
  tft.setTextSize(1);
  tft.print("SLOT MACHINE");

  tft.setCursor(90, 0);
  tft.print(balance);

  tft.drawRoundRect(UI_RECT0_X, UI_RECT_Y, UI_RECT_WIDTH, UI_RECT_WIDTH, UI_RECT_R, ST77XX_WHITE);
  tft.drawRoundRect(UI_RECT1_X, UI_RECT_Y, UI_RECT_WIDTH, UI_RECT_WIDTH, UI_RECT_R, ST77XX_WHITE);
  tft.drawRoundRect(UI_RECT2_X, UI_RECT_Y, UI_RECT_WIDTH, UI_RECT_WIDTH, UI_RECT_R, ST77XX_WHITE);
}

void printMelon(int position) {
  int x0 = UI_RECTS[position] + 3;
  int y0 = UI_RECT_Y + 3;
  tft.drawRGBBitmap(x0, y0, epd_bitmap_melon, UI_ITEM_WIDTH, UI_ITEM_WIDTH);
}

void print7(int position) {
  int x0 = UI_RECTS[position] + 3;
  int y0 = UI_RECT_Y + 3;
  tft.drawRGBBitmap(x0, y0, epd_bitmap_7, UI_ITEM_WIDTH, UI_ITEM_WIDTH);
}

void printOrange(int position) {
  int x0 = UI_RECTS[position] + 3;
  int y0 = UI_RECT_Y + 3;
  tft.drawRGBBitmap(x0, y0, epd_bitmap_orange, UI_ITEM_WIDTH, UI_ITEM_WIDTH);
}

void printCherry(int position) {
  int x0 = UI_RECTS[position] + 3;
  int y0 = UI_RECT_Y + 3;
  tft.drawRGBBitmap(x0, y0, epd_bitmap_cherry, UI_ITEM_WIDTH, UI_ITEM_WIDTH);
}

// Draw Win Text on Screen
void printWin(int win) {
  int x0 = 0;
  int y0 = 120;
  tft.setCursor(x0, y0);
  tft.setTextColor(ST77XX_BLUE);
  tft.setTextSize(2);
  tft.print("YOU'VE WON");
  tft.setTextColor(ST77XX_RED);
  tft.setTextSize(2);
  tft.print(win);
  tft.print(" Coins");

  balance = balance + win;

  delay(1000);
}

void printLowBalance() {
  int x0 = 0;
  int y0 = 140;
  tft.setCursor(x0, y0);
  tft.setTextColor(ST77XX_BLUE);
  tft.setTextSize(2);
  tft.print("NO MONEY!");
}

void printAuthors() {
  tft.fillScreen(ST7735_BLACK);
  tft.setCursor(0, 0);
  tft.setTextColor(ST77XX_BLUE);
  tft.setTextSize(1);
  tft.println("Made with <3 by\n");
  tft.println("Paul Braun\n");
  tft.println("Dennis Baetzel\n");
  tft.println("Bernd Storath");
}

void printHelp() {
  tft.fillScreen(ST7735_BLACK);
  tft.setCursor(0, 0);
  tft.setTextColor(ST77XX_YELLOW);
  tft.setTextSize(1);
  tft.println("Pay Table: \n");
  
  tft.println("3x 7 pays 5000");
  tft.println("Chance: 1,56%\n");
  
  tft.println("3x Cherry pays 500");
  tft.println("Chance: 1,56%\n");
  
  tft.println("3x Orange pays 500");
  tft.println("Chance: 1,56%\n");
  
  tft.println("3x Melon pays 2500");
  tft.println("Chance: 1,56%\n");
}